## arch/arm/Kconfig
```kconfig
menu "ARM architecture"
	depends on ARM

config SYS_ARCH
	default "arm"

config ARM64
	bool

config HAS_VBAR
        bool

config CPU_ARM720T
        bool

config CPU_ARM920T
        bool

config CPU_ARM926EJS
        bool

config CPU_ARM946ES
        bool

config CPU_ARM1136
        bool

config CPU_ARM1176
        bool
        select HAS_VBAR

config CPU_V7
        bool
        select HAS_VBAR

config CPU_V7M
	bool

config CPU_PXA
        bool

config CPU_SA1100
        bool

config SYS_CPU
        default "arm720t" if CPU_ARM720T
        default "arm920t" if CPU_ARM920T
        default "arm926ejs" if CPU_ARM926EJS
        default "arm946es" if CPU_ARM946ES
        default "arm1136" if CPU_ARM1136
        default "arm1176" if CPU_ARM1176
        default "armv7" if CPU_V7
        default "armv7m" if CPU_V7M
        default "pxa" if CPU_PXA
        default "sa1100" if CPU_SA1100
	default "armv8" if ARM64

config SEMIHOSTING
	bool "support boot from semihosting"
	help
	  In emulated environments, semihosting is a way for
	  the hosted environment to call out to the emulator to
	  retrieve files from the host machine.

config SYS_L2CACHE_OFF
	bool "L2cache off"
	help
	  If SoC does not support L2CACHE or one do not want to enable
	  L2CACHE, choose this option.

choice
	prompt "Target select"
	default ARCH_XINJIE

config ARCH_SUNXI
	bool "Support sunxi (Allwinner) SoCs"
	select CMD_USB
	select DM
	select DM_GPIO
	select DM_ETH
	select DM_SERIAL
	select DM_USB
	select OF_CONTROL
	select OF_SEPARATE
	select USB
	select USB_STORAGE
	select USB_KEYBOARD

config ARCH_XINJIE
	bool "Support xinjie Allwinner H3 SoCs"
	select CMD_USB
	select DM
	select DM_GPIO
	select DM_ETH
	select DM_SERIAL
	select DM_USB
	select OF_CONTROL
	select OF_SEPARATE
	select USB
	select USB_STORAGE
	select USB_KEYBOARD

endchoice


source "arch/arm/cpu/armv7/Kconfig"

source "board/xinjieH3/Kconfig"
source "board/sunxi/Kconfig"

source "arch/arm/Kconfig.debug"

endmenu
```

## board/xinjieH3/Kconfig
```kconfig
if ARCH_XINJIE

config MACH_XINJIE_H3
	bool "xinjie H3"
	select CPU_V7
	select SUPPORT_SPL

config MACH_XINJIE
	bool
	default y if MACH_XINJIE_H3

config SYS_CLK_FREQ
	default 1008000000 if MACH_XINJIE

config SYS_CONFIG_NAME
	default "xin8i" if MACH_XINJIE

config SYS_BOARD
	default "xinjieH3"

config SYS_SOC
	default "xinjie"

config UART0_PORT_F
	bool "UART0 on MicroSD breakout board"
	default n
	---help---
	Repurpose the SD card slot for getting access to the UART0 serial
	console. Primarily useful only for low level u-boot debugging on
	tablets, where normal UART0 is difficult to access and requires
	device disassembly and/or soldering. As the SD card can't be used
	at the same time, the system can be only booted in the FEL mode.
	Only enable this if you really know what you are doing.


endif
```

## configs/orangepi_one_defconfig
```kconfig
CONFIG_ARM=y
CONFIG_ARCH_XINJIE=y
CONFIG_MACH_XINJIE_H3=y
CONFIG_DRAM_CLK=672
CONFIG_DRAM_ZQ=3881979
CONFIG_DRAM_ODT_EN=y

# CONFIG_VIDEO is not set
# CONFIG_SYS_MALLOC_CLEAR_ON_INIT is not set

# CONFIG_CMD_IMLS is not set
# CONFIG_CMD_FLASH is not set
# CONFIG_CMD_FPGA is not set
```
